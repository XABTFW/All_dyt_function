## src/drivers/dyt_gimbal/Kconfig
```kconfig
menuconfig DRIVERS_DYT_GIMBAL
	bool "dyt_gimbal"
	default n
	---help---
		Enable support for the DYT serial gimbal telemetry driver.
```

## src/modules/cooperative_rendezvous/Kconfig
```kconfig
menuconfig MODULES_COOPERATIVE_RENDEZVOUS
	bool "cooperative_rendezvous"
	default n
	---help---
		Enable two-aircraft cooperative rendezvous position sharing and approach.
```

## src/modules/dyt_guidance/Kconfig
```kconfig
menuconfig MODULES_DYT_GUIDANCE
	bool "dyt_guidance"
	default n
	---help---
		Enable the DYT visual guidance controller module.
```

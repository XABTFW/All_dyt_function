## src/drivers/distance_sensor/sdm50/Kconfig
```kconfig
menuconfig DRIVERS_DISTANCE_SENSOR_SDM50
	bool "sdm50"
	default n
	---help---
		Enable support for the Siman SDM50 serial laser rangefinder.
```

## src/modules/comm_emergency/Kconfig
```kconfig
menuconfig MODULES_COMM_EMERGENCY
	bool "comm_emergency"
	default n
	---help---
		Communication-loss hold, battery, timeout and distance-gated mission/offboard recovery policy.
```

## src/modules/gnss_emergency/Kconfig
```kconfig
menuconfig MODULES_GNSS_EMERGENCY
	bool "gnss_emergency"
	default n
	---help---
		GNSS three-second data loss and zero-satellite landing with RC takeover.
```
